## configs/rv64_tlb_defconfig
```kconfig
CONFIG_ISA_riscv=y
CONFIG_RV64=y
CONFIG_TLB=y
CONFIG_TLB_ENTRIES=64
CONFIG_ENGINE_INTERPRETER=y
CONFIG_MODE_SYSTEM=y
CONFIG_TARGET_NATIVE_ELF=y
CONFIG_TRACE=y
CONFIG_ITRACE=y
CONFIG_TRACE_INTR=y
CONFIG_TRACE_MMU=y
CONFIG_TRACE_TLB=y
CONFIG_TRACE_ECALL=y
CONFIG_ITRACE_RINGBUF=128
CONFIG_TRACE_INTR_RINGBUF=32
CONFIG_TRACE_MMU_RINGBUF=32
CONFIG_TRACE_TLB_RINGBUF=32
CONFIG_TRACE_ECALL_RINGBUF=256
CONFIG_DEVICE=y
CONFIG_HAS_SERIAL=y
CONFIG_SERIAL_MMIO=0xa00003f8
CONFIG_HAS_TIMER=y
CONFIG_RTC_MMIO=0xa0000048
CONFIG_HAS_KEYBOARD=y
CONFIG_I8042_DATA_MMIO=0xa0000060
CONFIG_HAS_CLINT=y
CONFIG_HAS_PLIC=y
CONFIG_MBASE=0x80000000
CONFIG_MSIZE=0x8000000
CONFIG_PC_RESET_OFFSET=0
CONFIG_PMEM_GARRAY=y
CONFIG_MEM_RANDOM=y
```

## src/isa/riscv32/Kconfig
```kconfig
menu "ISA-dependent Options for riscv"

config RV64
  bool "64-bit RISC-V architecture"
  default n

config TLB
  bool "Enable split I/D TLB"
  default y

config TLB_ENTRIES
  depends on TLB
  int "Entries per split TLB"
  default 64

config RVE
  bool "Use E extension"
  default n
endmenu
```
